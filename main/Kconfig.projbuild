## main/Kconfig.projbuild
```kconfig
menu "Application-specific settings"

    menu "CAN settings"

        config CAN_TX_GPIO
            int "CAN TX GPIO"
            range 0 33
            default 23

        config CAN_RX_GPIO
            int "CAN RX GPIO"
            range 0 33
            default 22

        config CAN_RTR_TIMEOUT_MS
            int "RTR timeout (ms)"
            default 50
            help
                Timeout for Remote Transmission Request (RTR) responses.

    endmenu # CAN settings

    menu "ODrive settings"

        config ODRIVE_NODE_ID_M0
            int "Node-ID for Motor 0"
            range 0 255
            default 0

        config ODRIVE_NODE_ID_M1
            int "Node-ID for Motor 1"
            range 0 255
            default 1

        config ODRIVE_MAX_CALIBRATION_TIME_S
            int "Maximum calibration time (s)"
            default 20
            help
                Maximum time to wait for ODrive motor calibration to complete.

    endmenu # ODrive settings
    
    
    menu "micro-ROS application"

        menu "Messages"

            menu "Odometry"

                config MROS_ODOMETRY_TOPIC
                    string "micro-ROS odometry topic"
                    default "odom"

                config MROS_ODOMETRY_FRAME_ID
                    string "micro-ROS odometry frame ID"
                    default "odom"

                config MROS_ODOM_PUBLISHER_PERIOD_MS
                    int "Odometry publisher period (ms)"
                    default 100
                    help
                        Rate at which odometry messages are published.

            endmenu # Odometry

            menu "IMU"

                config MROS_IMU_TOPIC
                    string "micro-ROS IMU topic"
                    default "imu"

                config MROS_IMU_FRAME_ID
                    string "micro-ROS IMU frame ID"
                    default "imu"

                config MROS_IMU_PUBLISHER_PERIOD_MS
                    int "IMU publisher period (ms)"
                    default 100
                    help
                        Rate at which IMU messages are published.

            endmenu # IMU

        endmenu # Messages

        config MROS_NODE_NAME
            string "micro-ROS node name"
            default "car_node"

        config MROS_NODE_NAMESPACE
            string "micro-ROS node namespace"
            default ""
            help
                Leave empty for no namespace.

        config MROS_CMD_VEL_TOPIC
            string "micro-ROS cmd_vel topic"
            default "cmd_vel"

        config MROS_BASE_FRAME_ID
            string "micro-ROS base frame ID"
            default "base_link"

        config MROS_UART_BAUDRATE
            int "UART baudrate"
            default 460800
            help
                Baudrate of UART for MROS agent communication.

        config MROS_CMD_VEL_TIMEOUT_MS
            int "cmd_vel maximum timeout (ms)"
            default 200
            help
                Maximum allowed time since last received cmd_vel message before stopping the robot.

        config YAW_CORRECTION_PERIOD_MS
            int "Period in which the cmd_vel msgs are published (ms)"
            default 100

        config MROS_ENABLE_CONTROLLER_DATA_PUBLISH
            bool "Enable controller data publishing"
            default y
            help
                If enabled, publishes additional data from the controller such as setpoint, meassurement and control signal for each controll step in an array.

        menu "Controller data publishing settings"
        depends on MROS_ENABLE_CONTROLLER_DATA_PUBLISH

            config MROS_CONTROLLER_DATA_TOPIC
                string "micro-ROS controller data topic"
                default "ctrl_data"

            config MROS_CONTROLLER_DATA_PUBLISHER_PERIOD_MS
                int "Controller data publisher period (ms)"
                default 100
                help
                    Rate at which controller data messages are published.

            config MROS_CONTROLLER_DATA_SIZE
                int "Controller data array size"
                default 7
                help
                    Number of recent control steps to include in the published controller data array. The array will be 4 times this size as it includes [timestamp_t, r_t, y_t, u_t, timestamp_t-1, r_t-1, y_t-1, u_t-1, ...].

        endmenu # Controler data publishing settings

    endmenu # micro-ROS application
   
    menu "Yaw Controller settings"
        config MAX_ANG_VEL
            int "Maximum angular velocity (*1000)"
            help 
                Maximum angular velocity for yaw correction, multiplied by 1000 to allow for fractional values.
            default 2000

        config CORR_WEIGHT
            int "Correction weight (*1000)"
            help
                Weight for the yaw correction, multiplied by 1000 to allow for fractional values.
            default 0

        config KP
            int "Proportional gain (*1000)"
            help
                Proportional gain for the P controller, multiplied by 1000 to allow for fractional values.
            default 2000

        config PT2_D
            int "D (*1000)"
            help
                D value of the PT2 controller, multiplied by 1000 to allow for fractional values.
            default 800

        config PT2_W
            int "w (*1000)"
            help
                w value of the PT2 controller, multiplied by 1000 to allow for fractional values.
            default 2000

        config PT2_ENABLE
            bool "Enable PT2"
            help
                Use the PT2 controller instead of the P controller.
            default y

    endmenu # PID controller settings
    
    menu "Robot kinematics"

        config ROBOT_WHEEL_RADIUS_MM
            int "Wheel radius (mm)"
            default 32
            range 1 1000

        config ROBOT_TRACK_WIDTH_MM
            int "Track width (mm)"
            default 185
            range 1 1000

        config ROBOT_WHEEL_BASE_MM
            int "Wheelbase (mm)"
            default 255
            range 1 1000

    endmenu # Robot kinematics


    menu "Servo settings"

        config SERVO_GPIO
            int "Servo GPIO pin"
            range 0 33
            default 5
            help
                GPIO pin connected to the servo control signal.

        config SERVO_CALIBRATED_MIDDLE_OFFSET
            int "Servo calibrated middle offset"
            range -500 500
            default 46
            help
                Calibration offset for the servo middle position in microseconds.
                Adjust this value to align the servo to the true center position.

    endmenu # Servo settings

    menu "BNO055 I2C Settings"

        config BNO055_I2C_ADDRESS
            hex "BNO055 I2C Address"
            default 0x28
            range 0x00 0xFF

        config BNO055_I2C_PORT
            int "BNO055 I2C Port"
            default 0
            range 0 1

        config BNO055_I2C_SCL_GPIO
            int "BNO055 I2C SCL GPIO"
            range 0 33
            default 20

        config BNO055_I2C_SDA_GPIO
            int "BNO055 I2C SDA GPIO"
            range 0 33
            default 21

        config BNO055_I2C_FREQUENCY_HZ
            int "BNO055 I2C Frequency (Hz)"
            default 95000
            range 10000 1000000

    endmenu # BNO055 I2C Settings


    config ERROR_LED_GPIO
        int "Error-LED GPIO"
        range 0 33
        default 8

    config JTAG_BUFF_SIZE
        int "JTAG buffer size"
        range 0 1024
        default 1024
    
endmenu # Application-specific settings
    
```
